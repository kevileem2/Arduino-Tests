
// Load Wi-Fi library
#include <WiFi.h>
// similar webpage on 1 line , use minify ?? http://minifycode.com/html-minifier/

//const char* ssid = "DESKTOP-ID7JU42 8285";
//const char* password =  "X782$5w9";

//const char* ssid = "Arduino-CVO";
//const char* password = "";

const char* ssid = "WiFi-2.4-E918";
const char* password =  "wudz36zwrkb63";

const char indexpage[] = "<!DOCTYPE html><html lang=\"en\"><head><meta charset=\"UTF-8\"><meta name=\"viewport\" content=\"width=device-width, initial-scale=1.0\"><title>Web Server Test | CVO Leerstad - Arduino II | Index</title><link rel=\"stylesheet\" href=\"assets/css/main.css\"><link rel=\"stylesheet\" href=\"https://cdnjs.cloudflare.com/ajax/libs/materialize/1.0.0/css/materialize.min.css\"><link rel=\"stylesheet\" href=\"https://fonts.googleapis.com/icon?family=Material+Icons\"> <script src=\"https://cdnjs.cloudflare.com/ajax/libs/materialize/1.0.0/js/materialize.min.js\"></script> <script src=\"assets/js/main.js\"></script> </head><body> <header> <nav><div class=\"nav-wrapper red darken-1\"> <a href=\"index.html\" class=\"brand-logo center\"><i class=\"material-icons\">all_inclusive</i>Arduino</a></div> </nav> </header> <main><div class=\"container\"><div class=\"row\"><div class=\"col s12\"><div class=\"card horizontal\"><div class=\"card-image hide-on-med-and-down\t\"> <img src=\"assets/images/6.jpg\"></div><div class=\"card-stacked\"><div class=\"card-content\"><h3 class=\"red-text text-lighten-1\">This is a website to demonstrate my skills with html, css and javascript.</h3><p> Click on the button below to go the website.</p></div><div class=\"card-action\"> <a href=\"person.html\" class=\"waves-effect waves-light btn\">Go to the website!</a></div></div></div></div></div></div> </main> <footer class=\"page-footer\"><div class=\"container\"><div class=\"row\"><div class=\"col l6 s12\"><h5 class=\"white-text\">Information</h5><p class=\"grey-text text-lighten-4\">This Website is made in a school environment and is not used for commercial purposes.</p></div></div></div><div class=\"footer-copyright z-depth-1 red darken-1\"><div class=\"container\"> © 2019 Kevin Leemans</div></div> </footer></body></html>";
const char family[] ="<!DOCTYPE html><html lang=\"en\"><head><meta charset=\"UTF-8\"><meta name=\"viewport\" content=\"width=device-width, initial-scale=1.0\"><title>Web Server Test | CVO Leerstad - Arduino II | Family</title><link rel=\"stylesheet\" href=\"assets/css/main.css\"><link rel=\"stylesheet\" href=\"https://cdnjs.cloudflare.com/ajax/libs/materialize/1.0.0/css/materialize.min.css\"><link rel=\"stylesheet\" href=\"https://fonts.googleapis.com/icon?family=Material+Icons\"> <script src=\"https://cdnjs.cloudflare.com/ajax/libs/materialize/1.0.0/js/materialize.min.js\"></script> <script src=\"assets/js/main.js\"></script> </head><body> <header> <nav><div class=\"nav-wrapper red darken-1\"> <a href=\"index.html\" class=\"brand-logo\"><i class=\"material-icons nav__icon\">all_inclusive</i>Arduino</a> <a href=\"index.html\" data-target=\"mobile-demo\" class=\"sidenav-trigger\"><i class=\"material-icons\">menu</i></a><ul class=\"right hide-on-med-and-down\"><li><a href=\"person.html\">Person</a></li><li><a href=\"hobby.html\">Hobbies</a></li><li class=\"active\"><a href=\"family.html\">Family</a></li></ul></div> </nav><ul class=\"sidenav\" id=\"mobile-demo\"><li><a href=\"person.html\">Person</a></li><li><a href=\"hobby.html\">Hobbies</a></li><li class=\"active\"><a href=\"family.html\">Family</a></li></ul> </header> <main></main> <footer class=\"page-footer\"><div class=\"container\"><div class=\"row\"><div class=\"col l6 s12\"><h5 class=\"white-text\">Information</h5><p class=\"grey-text text-lighten-4\">This Website is made in a school environment and is not used for commercial purposes.</p></div></div></div><div class=\"footer-copyright z-depth-1 red darken-1\"><div class=\"container\"> © 2019 Kevin Leemans</div></div> </footer></body></html>";
const char hobby[] = "<!DOCTYPE html><html lang=\"en\"><head><meta charset=\"UTF-8\"><meta name=\"viewport\" content=\"width=device-width, initial-scale=1.0\"><title>Web Server Test | CVO Leerstad - Arduino II | Hobbies</title><link rel=\"stylesheet\" href=\"assets/css/main.css\"><link rel=\"stylesheet\" href=\"https://cdnjs.cloudflare.com/ajax/libs/materialize/1.0.0/css/materialize.min.css\"><link rel=\"stylesheet\" href=\"https://fonts.googleapis.com/icon?family=Material+Icons\"> <script src=\"https://cdnjs.cloudflare.com/ajax/libs/materialize/1.0.0/js/materialize.min.js\"></script> <script src=\"assets/js/main.js\"></script> </head><body> <header> <nav><div class=\"nav-wrapper red darken-1\"> <a href=\"index.html\" class=\"brand-logo\"><i class=\"material-icons nav__icon\">all_inclusive</i>Arduino</a> <a href=\"index.html\" data-target=\"mobile-demo\" class=\"sidenav-trigger\"><i class=\"material-icons\">menu</i></a><ul class=\"right hide-on-med-and-down\"><li><a href=\"person.html\">Person</a></li><li class=\"active\"><a href=\"hobby.html\">Hobbies</a></li><li><a href=\"family.html\">Family</a></li></ul></div> </nav><ul class=\"sidenav\" id=\"mobile-demo\"><li><a href=\"person.html\">Person</a></li><li class=\"active\"><a href=\"hobby.html\">Hobbies</a></li><li><a href=\"family.html\">Family</a></li></ul> </header> <main><div class=\"container\"><div class=\"row\"><div class=\"col s12 l6 xl4\"><div class=\"card\"><div class=\"card-image card__hobby\"> <img src=\"assets/images/fitness.jpg\"> <span class=\"card-title red darken-4\">Fitness</span></div><div class=\"card-stacked\"><div class=\"card-content\"><p>Dit is wat ik doe als ik me even moet ontspannen.</p><p>Als ik me eens moet afreageren.</p></div></div></div></div><div class=\"col s12 l6 xl4\"><div class=\"card\"><div class=\"card-image card__hobby\"> <img src=\"assets/images/programming.jpg\"> <span class=\"card-title red darken-4\">Programming</span></div><div class=\"card-stacked\"><div class=\"card-content\"><p>Dit is mijn passie.</p><p>Wil ik mijn job van maken.</p></div></div></div></div><div class=\"col s12 l6 xl4\"><div class=\"card\"><div class=\"card-image card__hobby\"> <img src=\"assets/images/gaming.jpg\"> <span class=\"card-title red darken-4\">Gaming</span></div><div class=\"card-stacked\"><div class=\"card-content\"><p>Dit is iets wat ik doe in mijn vrije tijd.</p><p>Ik speel dit competitief en voor geld.</p></div></div></div></div></div></div> </main> <footer class=\"page-footer\"><div class=\"container\"><div class=\"row\"><div class=\"col l6 s12\"><h5 class=\"white-text\">Information</h5><p class=\"grey-text text-lighten-4\">This Website is made in a school environment and is not used for commercial purposes.</p></div></div></div><div class=\"footer-copyright z-depth-1 red darken-1\"><div class=\"container\"> © 2019 Kevin Leemans</div></div> </footer></body></html>";
const char person[] = "<!DOCTYPE html><html lang=\"en\"><head><meta charset=\"UTF-8\"><meta name=\"viewport\" content=\"width=device-width, initial-scale=1.0\"><title>Web Server Test | CVO Leerstad - Arduino II | Person</title><link rel=\"stylesheet\" href=\"assets/css/main.css\"><link rel=\"stylesheet\" href=\"https://cdnjs.cloudflare.com/ajax/libs/materialize/1.0.0/css/materialize.min.css\"><link rel=\"stylesheet\" href=\"https://fonts.googleapis.com/icon?family=Material+Icons\"> <script src=\"https://cdnjs.cloudflare.com/ajax/libs/materialize/1.0.0/js/materialize.min.js\"></script> <script src=\"assets/js/main.js\"></script> </head><body> <header> <nav><div class=\"nav-wrapper red darken-1\"> <a href=\"index.html\" class=\"brand-logo\"><i class=\"material-icons nav__icon\">all_inclusive</i>Arduino</a> <a href=\"index.html\" data-target=\"mobile-demo\" class=\"sidenav-trigger\"><i class=\"material-icons\">menu</i></a><ul class=\"right hide-on-med-and-down\"><li class=\"active\"><a href=\"person.html\">Person</a></li><li><a href=\"hobby.html\">Hobbies</a></li><li><a href=\"family.html\">Family</a></li></ul></div> </nav><ul class=\"sidenav\" id=\"mobile-demo\"><li class=\"active\"><a href=\"person.html\">Person</a></li><li><a href=\"hobby.html\">Hobbies</a></li><li><a href=\"family.html\">Family</a></li></ul> </header> <main><div class=\"container\"><div class=\"row\"><div class=\"col l8 m12 offset-l2\"><div class=\"card horizontal\"><div class=\"card-image hide-on-small-only\"> <img src=\"assets/images/kevin.jpg\"></div><div class=\"card-stacked\"><div class=\"card-content\"><p class=\"valign-wrapper\"><i class=\"material-icons small person__icons\">person</i><strong class=\"person__detail\">Kevin Leemans</strong></p><p class=\"valign-wrapper\"><i class=\"material-icons small person__icons\">email</i><strong class=\"person__detail\">kevinleemans11@gmail.com</strong></p><p class=\"valign-wrapper\"><i class=\"material-icons small person__icons\">phone_android</i><strong class=\"person__detail\">+32 496/13 85 71</strong></p><p class=\"valign-wrapper\"><i class=\"material-icons small person__icons\">cake</i><strong class=\"person__detail\">10/10/1997</strong></p><p class=\"valign-wrapper\"><i class=\"material-icons small person__icons\">location_on</i><strong class=\"person__detail\">Begoniastraat 7, 9552, Borsbeke</strong></p><p class=\"valign-wrapper\"><i class=\"material-icons small person__icons\">favorite</i><strong class=\"person__detail\">Ongehuwd</strong></p><p class=\"valign-wrapper\"><i class=\"material-icons small person__icons\">directions_car</i><strong class=\"person__detail\">B</strong></p></div></div></div></div></div></div> </main> <footer class=\"page-footer\"><div class=\"container\"><div class=\"row\"><div class=\"col l6 s12\"><h5 class=\"white-text\">Information</h5><p class=\"grey-text text-lighten-4\">This Website is made in a school environment and is not used for commercial purposes.</p></div></div></div><div class=\"footer-copyright z-depth-1 red darken-1\"><div class=\"container\"> © 2019 Kevin Leemans</div></div> </footer></body></html>";
const char styles[] = "body {\n  display: flex;\n  min-height: 100vh;\n  flex-direction: column;\n  background-color: #EEE;\n}\n\nmain {\n  flex: 1 0 auto;\n}\n\n.nav__icon {\n  padding-left: 10px;\n}\n\n.person__icons{\n  color: #e53935;\n}\n\n.person__detail {\n  margin-left: 2%;\n}\n\n.card-content > p {\n  margin: 2% 0 !important;\n}\n\n.card-image img {\n  height:400px;\n}\n\n.card__hobby img {\n  height: 300px;\n}\n";
const char script[] = "document.addEventListener('DOMContentLoaded', function() {\n  const elems = document.querySelectorAll('.sidenav');\n  const instances = M.Sidenav.init(elems, this.options);\n});";
const char arduino[] = {0xFF, 0xD8, 0xFF, 0xE0, 0x00, 0x10, 0x4A, 0x46, 0x49, 0x46, 0x00, 0x01, 0x01,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 0xD9, };
const char fitness[] = {0xFF, 0xD8, 0xFF, 0xE0, 0x00, 0x10, 0x4A, 0x46, 0x49, 0x46, 0x00, 0x01, 0x01,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 0xD9, };
const char gaming[] = {0xFF, 0xD8, 0xFF, 0xE0, 0x00, 0x10, 0x4A, 0x46, 0x49, 0x46, 0x00, 0x01, 0x01,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 0xD9, };
const char kevin[] = {0xFF, 0xD8, 0xFF, 0xE0, 0x00, 0x10, 0x4A, 0x46, 0x49, 0x46, 0x00, 0x01, 0x01,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 0xD9, };
const char programming[] = {0xFF, 0xD8, 0xFF, 0xE0, 0x00, 0x10, 0x4A, 0x46, 0x49, 0x46, 0x00, 0x01, 0x01,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 0xD9, };

// Set web server port number to 80
WiFiServer server(80);

// Variable to store the HTTP request
String header;

void setup() {
  Serial.begin(115200);
  
  // Connect to Wi-Fi network with SSID and password
  Serial.print("Connecting to ");
  Serial.println(ssid);

  WiFi.begin(ssid, password);
  while (WiFi.status() != WL_CONNECTED) {
    delay(500);
    Serial.print(".");
  }
  // Print local IP address and start web server
  Serial.println("");
  Serial.println("WiFi connected.");
  Serial.println("IP address: ");
  Serial.println(WiFi.localIP());

  server.begin();
}

void loop() {
  WiFiClient client = server.available();   // Listen for incoming clients

  if (client) {                             // If a new client connects,
    Serial.println("New Client.");          // print a message out in the serial port
    String currentLine = "";                // make a String to hold incoming data from the client
    //header = "";
    while (client.connected()) {            // loop while the client's connected

      if (client.available()) {             // if there's bytes to read from the client,
        char c = client.read();             // read a byte, then
        Serial.write(c);                    // print it out the serial monitor
        header += c;
        if (c == '\n') {                    // if the byte is a newline character every line coming from browser ended by CRLF  or \r\n
          // if the current line is blank, you got two newline characters in a row.
          // that's the end of the client HTTP request, so send a response:

          if (currentLine.length() == 0) {

            if (header.indexOf("GET /index.html") >= 0) {
              client.println("HTTP/1.1 200 OK");
              client.println("Content-type:text/html");
              client.print("Content-length:");client.println(sizeof(indexpage)-1);
              client.println("Connection:close");
              client.println("");
              client.print(indexpage);
              
              Serial.println("ESP sended index page to client");
              
            }else if (header.indexOf("GET /family.html") >= 0) {
              client.println("HTTP/1.1 200 OK");
              client.println("Content-type:text/html");
              client.print("Content-length:");client.println(sizeof(family)-1);
              client.println("Connection:close");
              client.println("");
              client.print(family);
              
              Serial.println("ESP sended family page to client");
              
            }else if (header.indexOf("GET /hobby.html") >= 0) {
              client.println("HTTP/1.1 200 OK");
              client.println("Content-type:text/html");
              client.print("Content-length:");client.println(sizeof(hobby)-1);
              client.println("Connection:close");
              client.println("");
              client.print(hobby);
              
              Serial.println("ESP sended hobby page to client");
              
            }else if (header.indexOf("GET /person.html") >= 0) {
              client.println("HTTP/1.1 200 OK");
              client.println("Content-type:text/html");
              client.print("Content-length:");client.println(sizeof(person)-1);
              client.println("Connection:close");
              client.println("");
              client.print(person);
              
              Serial.println("ESP sended person page to client");
              
            }else if (header.indexOf("GET /assets/css/main.css") >= 0) {
              client.println("HTTP/1.1 200 OK");
              client.println("Content-type:text/css");
              client.print("Content-length:");client.println(sizeof(styles)-1);
              client.println("Connection:close");
              client.println("");
              client.print(styles);
              
              Serial.println("ESP sended css file to client");

            }else if (header.indexOf("GET /assets/js/main.js") >= 0) {
              client.println("HTTP/1.1 200 OK");
              client.println("Content-type:text/javascript");
              client.print("Content-length:");client.println(sizeof(script)-1);
              client.println("Connection:close");
              client.println("");
              client.print(script);
              
              Serial.println("ESP sended javascript file to client");

            }else if (header.indexOf("GET /assets/images/6.jpg") >= 0) {
              client.println("HTTP/1.1 200 OK");
              client.println("Content-type:image/ico");
              client.print("Content-length:"); client.println(sizeof(arduino));
              Serial.println(sizeof(arduino));
              client.println("Connection:close");
              client.println("");
              client.write(arduino,sizeof(arduino));

              Serial.println("ESP sended arduino image to client:\n\r");                          
              
            }else if (header.indexOf("GET /assets/images/fitness.jpg") >= 0) {
              client.println("HTTP/1.1 200 OK");
              client.println("Content-type:image/ico");
              client.print("Content-length:"); client.println(sizeof(fitness));
              Serial.println(sizeof(fitness));
              client.println("Connection:close");
              client.println("");
              client.write(fitness,sizeof(fitness));

              Serial.println("ESP sended fitness image to client:\n\r");                          
              
            }else if (header.indexOf("GET /assets/images/gaming.jpg") >= 0) {
              client.println("HTTP/1.1 200 OK");
              client.println("Content-type:image/ico");
              client.print("Content-length:"); client.println(sizeof(gaming));
              Serial.println(sizeof(gaming));
              client.println("Connection:close");
              client.println("");
              client.write(gaming,sizeof(gaming));

              Serial.println("ESP sended gaming image to client:\n\r");                          
              
            }else if (header.indexOf("GET /assets/images/kevin.jpg") >= 0) {
              client.println("HTTP/1.1 200 OK");
              client.println("Content-type:image/ico");
              client.print("Content-length:"); client.println(sizeof(kevin));
              Serial.println(sizeof(kevin));
              client.println("Connection:close");
              client.println("");
              client.write(kevin,sizeof(kevin));

              Serial.println("ESP sended kevin image to client:\n\r");                          
              
            }else if (header.indexOf("GET /assets/images/programming.jpg") >= 0) {
              client.println("HTTP/1.1 200 OK");
              client.println("Content-type:image/ico");
              client.print("Content-length:"); client.println(sizeof(programming));
              Serial.println(sizeof(programming));
              client.println("Connection:close");
              client.println("");
              client.write(programming,sizeof(programming));

              Serial.println("ESP sended programming image to client:\n\r");                          
              
            }else if (header.indexOf("GET /") >= 0) {
              client.println("HTTP/1.1 200 OK");
              client.println("Content-type:text/html");
              client.print("Content-length:");client.println(sizeof(indexpage)-1);
              client.println("Connection:close");
              client.println("");
              client.print(indexpage);
              
              Serial.println("ESP sended index page to client");
              
            }
            break; // jumps out of closed loop .. here the while( client.connected)

          } else { // if you got a newline, then clear currentLine

            currentLine = "";

          }
        } else if (c != '\r') {  // if you got anything else but a carriage return character,
          currentLine += c;      // add it to the end of the currentLine
        }
      }
    }
    // Clear the header variable
    header = "";
    // Close the connection
    client.stop();
    Serial.println("Client disconnected.");
    Serial.println("");
    delay(250);
  }
}
